VERSION ""

NS_ :

BS_:

BU_: RearRight_Node RearLeft_Node FrontRight_Node FrontLeft_Node_ Central_note

BO_ 257 TurnRightLamp: 1 Central_note
 SG_ TurnRight : 0|1@1+ (1,0) [0|0] ""  RearRight_Node,FrontRight_Node

BO_ 256 TurnLeftLamp: 1 Central_note
 SG_ TurnLeft : 0|1@1+ (1,0) [0|0] ""  RearLeft_Node,FrontLeft_Node_

EV_ evRearRight: 0 [0|1] "" 0 1 DUMMY_NODE_VECTOR0 Vector__XXX;

EV_ evFrontRight: 0 [0|1] "" 0 2 DUMMY_NODE_VECTOR0 Vector__XXX;

EV_ evRearLeft: 0 [0|1] "" 0 3 DUMMY_NODE_VECTOR0 Vector__XXX;

EV_ evFrontLeft: 0 [0|1] "" 0 4 DUMMY_NODE_VECTOR0 Vector__XXX;

EV_ evAlarm: 0 [0|1] "" 0 5 DUMMY_NODE_VECTOR0 Vector__XXX;

EV_ evTurnRight: 0 [0|1] "" 0 6 DUMMY_NODE_VECTOR0 Vector__XXX;

EV_ evTurnLeft: 0 [0|1] "" 0 7 DUMMY_NODE_VECTOR0 Vector__XXX;
