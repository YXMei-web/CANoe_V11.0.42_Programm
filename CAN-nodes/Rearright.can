/*@!Encoding:1252*/
variables {
      message TurnRightLamp TR;
}

on message TurnRightLamp {
      putValue (evRearRight, this.TurnRight);
}

